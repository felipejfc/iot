## nordic/light_switch-lp/sysbuild/mcuboot/boards/promicro_nrf52840_nrf52840.conf
```kconfig
# MCUboot configuration for Pro Micro nRF52840
# Disable QSPI as promicro doesn't have external flash
CONFIG_NORDIC_QSPI_NOR=y

# Disable USB in bootloader
CONFIG_USB_DEVICE_STACK=n
```
